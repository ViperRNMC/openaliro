## CMakeLists.txt
```
# Minimal standalone Zephyr app that stands up the Woz UWB engine on ESP32-S3.
# Pulls in the engine + the ISC DW3000 driver as out-of-tree modules and applies
# the DW3000 devicetree overlay, then find_package(Zephyr) as usual.
cmake_minimum_required(VERSION 3.20.0)

# repo root = ports/esp32s3/sample -> ../../..
get_filename_component(REPO_ROOT ${CMAKE_CURRENT_SOURCE_DIR}/../../.. ABSOLUTE)

list(APPEND EXTRA_ZEPHYR_MODULES
  ${REPO_ROOT}/modules/woz_uwb
  ${REPO_ROOT}/deps/dw3000)

# DW3000 pins/side-band GPIOs for this board (edit ../dw3000.overlay to rewire).
set(DTC_OVERLAY_FILE ${CMAKE_CURRENT_SOURCE_DIR}/../dw3000.overlay)

find_package(Zephyr REQUIRED HINTS $ENV{ZEPHYR_BASE})
project(woz_esp32s3_ranging)

target_sources(app PRIVATE src/main.c)
```

## prj.conf
```kconfig
# Woz UWB ranging engine on ESP32-S3 (DW3000 over SPI2). See ports/esp32s3/README.md.

# --- Engine layers (each depends on the one below) ---
CONFIG_WOZ_UWB=y
CONFIG_WOZ_UWB_RESPONDER=y
CONFIG_WOZ_ALIRO=y

# --- Crypto seam: mbedTLS AES (no Nordic PSA backend on ESP32) ---
CONFIG_WOZ_CRYPTO_MBEDTLS=y

# --- DW3000 decadriver (deps/dw3000): enable + select the seated chip ---
CONFIG_DW3000=y
CONFIG_DW3000_CHIP_DW3000=y

# --- Peripherals (WOZ_UWB already select's SPI+GPIO; explicit for clarity) ---
CONFIG_SPI=y
CONFIG_GPIO=y
# REQUIRED: the DW3000 driver drives SPI via spi_transceive_signal() (async).
# The ESP32-S3 SPI driver only wires .transceive_async under CONFIG_SPI_ASYNC.
CONFIG_SPI_ASYNC=y

# --- Codec allocates via k_malloc; give it a heap ---
CONFIG_HEAP_MEM_POOL_SIZE=16384
CONFIG_MAIN_STACK_SIZE=4096

# --- Logging ---
CONFIG_LOG=y
```

## src/main.c
```c
/*
 * Woz UWB ranging engine on ESP32-S3 — minimal bring-up sample.
 *
 * Binds a canned URSK and starts the CCC DS-TWR responder on the DW3000, then
 * polls for a range. With no iPhone/initiator present this proves the SPI +
 * DW3000 + CCC init path comes up on ESP32-S3; a live range needs a peer that
 * drives the DS-TWR exchange (an Aliro Wallet, or a second board as initiator).
 *
 * Reference scaffold (see ports/esp32s3/README.md) — not yet built on silicon.
 */
#include <zephyr/kernel.h>
#include <zephyr/logging/log.h>

#include "woz_uwb_facade.h"

LOG_MODULE_REGISTER(woz_esp32s3, LOG_LEVEL_INF);

/* Dummy 32-byte URSK for a peerless bring-up smoke test (mirrors uwb_selftest.c). */
static const uint8_t demo_ursk[32] = {
	0x11, 0x22, 0x33, 0x44, 0x55, 0x66, 0x77, 0x88, 0x99, 0xaa, 0xbb,
	0xcc, 0xdd, 0xee, 0xff, 0x00, 0x11, 0x22, 0x33, 0x44, 0x55, 0x66,
	0x77, 0x88, 0x99, 0xaa, 0xbb, 0xcc, 0xdd, 0xee, 0xff, 0x00,
};

// Sample entry point: starts an Aliro UWB responder session with fixed demo parameters and polls for range results.
// Calls woz_uwb_start_aliro() with a hardcoded session config (channel, slot timing, STS index, and demo_ursk) and logs whether the DW3000 responder came up. Then loops forever, polling woz_uwb_last_range_cm() every 500 ms and logging any new range measurement. Never returns in practice.
int main(void)
{
	// Aliro UWB session configuration for the sample: session ID, channel, sync code, slot/block timing, STS index, initial UWB time, and URSK used to start the responder via woz_uwb_start_aliro().
	const struct woz_uwb_aliro_cfg cfg = {
		.session_id = 0x02b02fd4u,
		.channel = 9u,
		.sync_code_index = 9u,
		.slot_duration_rstu = 2400u,
		.block_duration_ms = 192u,
		.slot_per_round = 12u,
		.sts_index0 = 0x1196e79du,
		.uwb_time_us = 0u,
		.ursk = demo_ursk,
	};
	int rc = woz_uwb_start_aliro(&cfg);

	LOG_INF("woz_uwb_start_aliro() = %d %s", rc,
		rc == 0 ? "(DW3000 up, responder listening)"
			: "(FAILED -- check wiring/SPI)");

	while (1) {
		int32_t cm;

		if (woz_uwb_last_range_cm(&cm)) {
			LOG_INF("range: %d cm", cm);
		}
		k_sleep(K_MSEC(500));
	}
	return 0;
}
```
