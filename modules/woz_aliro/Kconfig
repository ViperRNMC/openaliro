## modules/woz_aliro/Kconfig
```kconfig
# Woz Aliro credential-auth stack — the open replacement for the closed
# libaliro/libaliro_ble reader engine. Shared by the ESP32-S3 port (where it is
# the only implementation) and, behind this option, the nRF5340 build.
#
# Distinct from WOZ_ALIRO in modules/woz_uwb, which names the CCC/STS *ranging*
# engine below this layer and is unrelated.

config WOZ_ALIRO_STACK
	bool "Woz Aliro credential-auth stack (open libaliro replacement)"
	help
	  Compile the open Aliro reader core: the credential-auth key schedule
	  (X9.63/HKDF -> session keys, URSK, BleSK), the AES-256-GCM secure
	  channel, the BER-TLV/ISO7816 wire codec, and the reader trust store.

	  This builds the platform-agnostic core only. It provides no BLE
	  transport and does not displace libaliro on its own; the nRF5340 build
	  still links the closed archive.

module = WOZ_ALIRO
module-str = woz_aliro
source "subsys/logging/Kconfig.template.log_config"
```

## modules/woz_uwb/Kconfig
```kconfig
# Woz UWB engine for the Nordic door-lock add-on (NCS v3.3.0).
# Options: WOZ_UWB / WOZ_UWB_RESPONDER / WOZ_ALIRO.

config WOZ_UWB
	bool "Woz UWB (DW3000) bring-up"
	select SPI
	select GPIO
	help
	  Compile the minimal DW3110 (DWM3000EVB) bring-up driver (uwb_min.c).

config WOZ_UWB_RESPONDER
	bool "Woz DS-TWR responder"
	depends on WOZ_UWB
	help
	  DS-TWR responder that produces a distance in cm. Runs on the ISC
	  deps/dw3000 driver via ccc_shim_rx.c.

config WOZ_ALIRO
	bool "Woz Aliro/CCC credential-bound STS engine"
	depends on WOZ_UWB_RESPONDER
	help
	  CCC credential-bound STS substitution (ccc_shim + --wrap). Consumes an
	  externally supplied URSK (the add-on hands us the plaintext URSK in
	  UltraWideBandImpl::_ConfigureRangingSession).

choice
	prompt "AES-ECB backend for the CCC key ladder"
	default WOZ_CRYPTO_PSA
	depends on WOZ_ALIRO
	help
	  Selects which file defines crypto_aes_ecb_encrypt() (ccc_kdf.h) — the one
	  AES-128/256 ECB primitive the whole CCC key ladder and AES-CCM* build on.
	  This is the only per-platform crypto seam; see docs/porting.md.

config WOZ_CRYPTO_PSA
	bool "PSA Crypto (nRF/NCS default)"
	help
	  ccc_crypto_psa.c over the PSA Crypto API (nrf_security / CryptoCell on nRF).
	  Default: the nRF build is byte-identical to before this option existed.

config WOZ_CRYPTO_MBEDTLS
	bool "mbedTLS AES (ESP32-S3 / generic Zephyr)"
	select MBEDTLS
	help
	  ccc_crypto_mbedtls.c over mbedtls_aes_crypt_ecb — no PSA dependency, for
	  SoCs without nrf_security's PSA backend (e.g. ESP32-S3, which has
	  hardware-accelerated AES via mbedTLS). See ports/esp32s3/.
endchoice

config WOZ_UWB_SELFTEST
	bool "One-shot UWB init self-test after boot (diagnostic; no iPhone)"
	depends on WOZ_ALIRO
	help
	  Fire woz_uwb_start_aliro() once, CONFIG_WOZ_UWB_SELFTEST_DELAY_MS after boot,
	  with a canned ranging config, to capture the DW3000 bring-up + Pre-POLL listen
	  DIAG over RTT WITHOUT commissioning + a live Wallet Aliro UWB solicitation. This
	  isolates the HW/radio init from the Aliro credential path. Diagnostic only —
	  never enable in a shipping image.

config WOZ_UWB_SELFTEST_DELAY_MS
	int "UWB self-test delay after boot (ms)"
	depends on WOZ_UWB_SELFTEST
	default 15000
	help
	  Delay before the one-shot woz_uwb_start_aliro(). Keep generous so Thread has
	  rejoined on an already-commissioned device before the deferred 128 MHz
	  HFCLK boost that the first UWB entry performs.

config WOZ_PRETTY_SHELL
	bool "Clean/curated UART log output (suppress bring-up diagnostics)"
	depends on WOZ_ALIRO
	help
	  Collapse the verbose bring-up console into a curated timeline (tap ->
	  auth -> ranging -> unlock). When set, the per-frame RX diagnostics in
	  ccc_shim_rx.c / uwb_rxdiag.c compile to no-ops (DIAGK, see woz_diag.h),
	  one clean per-block ranging line is emitted instead, and the app re-emits
	  the commissioning QR URL through its own logger so Matter can drop to WRN.
	  Pairs with integration/overlays/woz-pretty.conf, which carries the
	  matching log-level cuts. Default n = today's verbose output, byte-for-byte.
	  Reverse by dropping the PRETTY=1 build switch (flag returns to n).
```

## ports/esp32/apps/matter-lock/main/Kconfig.projbuild
```kconfig
menu "Example Configuration"

    config ENABLE_ALIRO_BLE_UWB
        bool "Enable Aliro (Apple Home Key) over BLE + UWB"
        default y
        help
            Advertise the Door Lock cluster's Aliro Provisioning + BLE-UWB
            features and register the Aliro reader delegate, so Apple Home can
            provision an Express (BLE + UWB) Home Key into Wallet for this reader.

endmenu
```

## ports/esp32/apps/matter-lock/sdkconfig.defaults
```kconfig
CONFIG_ESPTOOLPY_FLASHSIZE_4MB=y

#enable BT
CONFIG_BT_ENABLED=y
CONFIG_BT_NIMBLE_ENABLED=y

#disable BT connection reattempt
CONFIG_BT_NIMBLE_ENABLE_CONN_REATTEMPT=n

# Enable L2CAP Connection-Oriented Channels: the Aliro credential-auth transaction
# rides an L2CAP CoC on the reader's SPSM. Default esp-matter NimBLE leaves this at
# 0, so ble_l2cap_create_server() returns BLE_HS_ENOTSUP. Match the bench reader app.
CONFIG_BT_NIMBLE_L2CAP_COC_MAX_NUM=2

# The Aliro reader runs its P-256 credential-auth (ECDH + ECDSA sign/verify + HKDF)
# inside the NimBLE L2CAP callback, i.e. on the nimble_host task. The 4096-byte
# default overflows that stack mid-transaction; the software P-256 path needs more.
CONFIG_BT_NIMBLE_HOST_TASK_STACK_SIZE=16384

# Trap stack overflows where they happen, not at the next context switch. The canary
# check (FREERTOS_CHECK_STACKOVERFLOW_CANARY) only runs on a switch, so a task that
# overruns and then returns through the clobbered frame crashes with a corrupted
# backtrace and no task name. The watchpoint panics on the first write into the last
# 32 bytes of any task stack and names the culprit.
CONFIG_FREERTOS_WATCHPOINT_END_OF_STACK=y

#enable lwip ipv6 autoconfig
CONFIG_LWIP_IPV6_AUTOCONFIG=y

# Use a custom partition table
CONFIG_PARTITION_TABLE_CUSTOM=y
CONFIG_PARTITION_TABLE_FILENAME="partitions.csv"
CONFIG_PARTITION_TABLE_OFFSET=0xC000

# Disable the CHIP shell: main/app_shell.cpp runs an esp_console REPL on the
# console UART instead, and only one reader of that UART can exist.
CONFIG_ENABLE_CHIP_SHELL=n

# This example only use 2 dynamic endpoints
CONFIG_ESP_MATTER_MAX_DYNAMIC_ENDPOINT_COUNT=2

#enable lwIP route hooks
CONFIG_LWIP_HOOK_IP6_ROUTE_DEFAULT=y
CONFIG_LWIP_HOOK_ND6_GET_GW_DEFAULT=y

# Button
CONFIG_BUTTON_PERIOD_TIME_MS=20
CONFIG_BUTTON_LONG_PRESS_TIME_MS=5000

# disable softap by default
CONFIG_ESP_WIFI_SOFTAP_SUPPORT=n

# Enable OTA Requestor
CONFIG_ENABLE_OTA_REQUESTOR=y

# Use compact attribute storage mode
CONFIG_ESP_MATTER_NVS_USE_COMPACT_ATTR_STORAGE=y

# Enable HKDF in mbedtls
CONFIG_MBEDTLS_HKDF_C=y

CONFIG_ENABLE_WIFI_AP=n

# Increase LwIP IPv6 address number to 6 (MAX_FABRIC + 1)
# unique local addresses for fabrics(MAX_FABRIC), a link local address(1)
CONFIG_LWIP_IPV6_NUM_ADDRESSES=6

# ESP32-DevKitC Settings
# Buttons
CONFIG_BSP_BUTTONS_NUM=1
CONFIG_BSP_BUTTON_1_TYPE_GPIO=y
CONFIG_BSP_BUTTON_1_GPIO=0
CONFIG_BSP_BUTTON_1_LEVEL=0
# LEDs
CONFIG_BSP_LEDS_NUM=0

# configurations required for diagnostic logs cluster
# Enable the diagnostic logs transfer over BDX protocol
CONFIG_CHIP_ENABLE_BDX_LOG_TRANSFER=y

CONFIG_ESP32_ENABLE_COREDUMP_TO_FLASH=y
CONFIG_ESP32_COREDUMP_DATA_FORMAT_ELF=y

# disable groupcast cluster until verified
CONFIG_SUPPORT_GROUPCAST_CLUSTER=n

# Advertise Aliro (Apple Home Key) Provisioning + BLE-UWB and register the reader delegate
CONFIG_ENABLE_ALIRO_BLE_UWB=y

# Keep BLE up after commissioning (do NOT deinit/reclaim it). Required for the
# Aliro reader to coexist on Matter's NimBLE host; also, reclaiming BLE makes any
# later nimble_port_init() crash the controller (btdm_controller_init fault).
CONFIG_USE_BLE_ONLY_FOR_COMMISSIONING=n
```

## ports/esp32/apps/reader/sdkconfig.defaults
```kconfig
# ESP32-S3 target; 16 MB flash (N16R8). PSRAM left off for Phase 1 (engine hot
# buffers belong in internal SRAM anyway).
CONFIG_IDF_TARGET="esp32s3"
CONFIG_ESPTOOLPY_FLASHSIZE_16MB=y

# 1 kHz tick so k_msleep(ms) has 1 ms granularity (default 100 Hz = 10 ms).
CONFIG_FREERTOS_HZ=1000

# The codec allocates + the DS-TWR bring-up runs on the main task.
CONFIG_ESP_MAIN_TASK_STACK_SIZE=8192

# Matter-ready flash layout (see partitions.csv). Phase 1 uses only `factory`;
# staged now so adding esp-matter later needs no reshuffle. PSRAM stays off until
# Matter is added (its heap wants it) — a deliberate Phase-2 flip, not needed here.
CONFIG_PARTITION_TABLE_CUSTOM=y
CONFIG_PARTITION_TABLE_CUSTOM_FILENAME="partitions.csv"

# Phase 2 BLE transport: NimBLE host (Aliro GATT service + L2CAP CoC). BLE-only
# on the S3; NimBLE is the peripheral host. L2CAP CoC carries the Aliro
# transaction (M1-M4); allow a couple of concurrent sessions.
CONFIG_BT_ENABLED=y
CONFIG_BT_NIMBLE_ENABLED=y
CONFIG_BT_NIMBLE_L2CAP_COC_MAX_NUM=2

# Colored log levels + colored console prompt (esp_console_setup_prompt only
# colors the prompt when this is on; it still falls back to plain text on
# terminals that fail the escape-sequence probe).
CONFIG_LOG_COLORS=y
```

## west.yml
```yaml
# west.yml — pin record + optional manifest for the aliro-nfc-uwb build.
#
# The public Nordic door-lock add-on (below) is itself a west manifest that
# imports NCS (sdk-nrf v3.3.0) + Zephyr + all modules, so pulling it at this exact
# rev reproduces the ~6 GB build workspace.
#
# The project-specific modules (woz_* and dw3000) live in THIS tree and are added
# to the build via ZEPHYR_EXTRA_MODULES. They are intentionally NOT west projects.
#
# Bootstrap manually (or just run ../bootstrap.sh, which does this):
#   git clone https://github.com/nrfconnect/ncs-door-lock-and-access-control <ws>/ncs-door-lock-and-access-control
#   git -C <ws>/ncs-door-lock-and-access-control checkout a5ad7fde1041d81690710a949c98eda1985fee0b
#   west init -l <ws>/ncs-door-lock-and-access-control   # NOT `init -m … --mr <SHA>`:
#   cd <ws> && west update                               #   `--mr <SHA>` => git clone --branch <SHA>, invalid

manifest:
  remotes:
    - name: nrfconnect
      url-base: https://github.com/nrfconnect

  projects:
    # Nordic Aliro door-lock + access-control add-on (public). Its own west.yml
    # imports sdk-nrf v3.3.0 (+ zephyr + modules).
    - name: ncs-door-lock-and-access-control
      remote: nrfconnect
      revision: a5ad7fde1041d81690710a949c98eda1985fee0b
      import: true

  self:
    path: aliro-nfc-uwb
```
